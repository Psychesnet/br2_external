## Config.in
```kconfig
menu "Bits of example"
source "$BR2_EXTERNAL_PROJECT_PATH/example/hello/Config.in"
source "$BR2_EXTERNAL_PROJECT_PATH/example/script/Config.in"
source "$BR2_EXTERNAL_PROJECT_PATH/example/libfoo/Config.in"
endmenu
```

## configs/project1_defconfig
```kconfig
BR2_x86_64=y
BR2_x86_corei7=y
BR2_PACKAGE_OVERRIDE_FILE="$(BR2_EXTERNAL_PROJECT_PATH)/override/local.mk"
BR2_PACKAGE_HELLO=y
BR2_PACKAGE_SCRIPT=y
BR2_PACKAGE_LIBFOO=y
```

## example/hello/Config.in
```kconfig
config BR2_PACKAGE_HELLO
     bool "hello"
     help
       hello example program
```

## example/libfoo/Config.in
```kconfig
config BR2_PACKAGE_LIBFOO
     bool "libfoo"
     help
       hello example library
```

## example/script/Config.in
```kconfig
config BR2_PACKAGE_SCRIPT
     bool "script"
     help
       hello example script
```
